## boards/shields/Pyuron/Kconfig.defconfig
```kconfig
# 1. 左右共通の設定（どちらのシールドが有効でも適用される）
if SHIELD_Pyuron_L || SHIELD_Pyuron_R

config ZMK_KEYBOARD_NAME
    default "Pyuron"

config NFCT_PINS_AS_GPIOS
    default y

config ZMK_SPLIT
    default y

config ZMK_POINTING
    default y

# cormoran/zmk-driver-pmw3610-with-custom-studio-rpc のドライバ本体
# (DT に compatible = "cormoran,pmw3610" のノードが無ければ自動的に無効)
config PMW3610
    default y

# ※ PAW3222 がドライバ側にKconfig定義がない場合はエラーになるため除外するか、
#    ドライバ側の正しい変数名に合わせてください。ここでは安全のためコメントアウトまたは除外を推奨
config PAW3222
    default y

config INPUT
    default y

config SPI
    default y

config RGBLED_WIDGET_BATTERY_LEVEL_HIGH
    default 30

config RGBLED_WIDGET_BATTERY_LEVEL_CRITICAL
    default 10

endif


# 2. 右側（Central / 親）専用の設定
if SHIELD_Pyuron_R

config ZMK_BLE
    default y

config ZMK_SPLIT_ROLE_CENTRAL
    default y

endif
```

## config/boards/shields/Pyuron/Kconfig.defconfig
```kconfig
if SHIELD_PYURON_R

config ZMK_KEYBOARD_NAME
    default "Pyuron_R"

config ZMK_BLE
    default y

config ZMK_SPLIT_ROLE_CENTRAL
    default y

config INPUT
    default y

config ZMK_POINTING
    default y

config SPI
    default y

config PAW3222
    default y


endif

if SHIELD_PYURON_R || SHIELD_PYURON_L

config NFCT_PINS_AS_GPIOS
    default y

config ZMK_SPLIT
    default y

config RGBLED_WIDGET_BATTERY_LEVEL_HIGH
    default 30

config RGBLED_WIDGET_BATTERY_LEVEL_CRITICAL
    default 10
    
config ZMK_POINTING
    default y

config PAW3222
    default y

endif
```

## config/boards/shields/Pyuron/Kconfig.shield
```kconfig
config SHIELD_PYURON_R
    def_bool $(shields_list_contains,Pyuron_R)

config SHIELD_PYURON_L
    def_bool $(shields_list_contains,Pyuron_L)
# PAW3222 トラックボール用設定の宣言
config PAW3222
    bool "PAW3222 trackball support"
    default n
```
